/*
 * Copyright (c) 2024 The ZMK Contributors
 *
 * SPDX-License-Identifier: MIT
 */

/ {
    behaviors {
        /omit-if-no-ref/ version: version_info {
            compatible = "zmk,behavior-version";
            #binding-cells = <0>;
        };
    };
};
