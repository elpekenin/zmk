## app/boards/arm/weact_stm32h750/Kconfig.board
```kconfig
config BOARD_WEACT_STM32H750
    bool "STM32H750 Development Board"
    depends on SOC_STM32H750XX
    select CPU_CORTEX_M7
```

## app/boards/arm/weact_stm32h750/Kconfig.defconfig
```kconfig
if BOARD_WEACT_STM32H750

config BOARD
    default "WEACT_STM32H750"

config DISK_DRIVER_SDMMC
    default y

config ZMK_USB
    default y

config ZMK_KSCAN_DIRECT_POLLING
    default y

config USB_DEVICE_STACK
    default y

# config FLASH_BASE_ADDRESS
#   default 0x90000000

# config BUILD_OUTPUT_UF2_USE_FLASH_BASE
#   default y

endif # BOARD_WEACT_STM32H750
```

## app/boards/arm/weact_stm32h750/weact_stm32h750_defconfig
```kconfig
# SPDX-License-Identifier: Apache-2.0

CONFIG_SOC_SERIES_STM32H7X=y
CONFIG_SOC_STM32H750XX=y

CONFIG_BOARD_WEACT_STM32H750=y

# enable GPIO
CONFIG_GPIO=y

# Enable clocks
CONFIG_CLOCK_CONTROL=y

# Enable MPU
CONFIG_ARM_MPU=y

# Enable HW stack protection
CONFIG_HW_STACK_PROTECTION=y

# enable pin controller
CONFIG_PINCTRL=y

CONFIG_ZMK_USB_LOGGING=y
```

## app/dts/bindings/behaviors/zmk,behavior-version.yaml
```yaml
# Copyright (c) 2024 The ZMK Contributors
# SPDX-License-Identifier: MIT

description: Show version info

compatible: "zmk,behavior-version"

include: zero_param.yaml
```
